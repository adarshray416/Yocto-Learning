## Task 2 - Create Tiff Image/conf/layer.conf
```bitbake
# We have a conf and classes directory, add to BBPATH
BBPATH .= ":${LAYERDIR}"

# We have recipes-* directories, add to BBFILES
BBFILES += "${LAYERDIR}/recipes-*/*/*.bb \
            ${LAYERDIR}/recipes-*/*/*.bbappend"

BBFILE_COLLECTIONS += "meta-tiff-app"
BBFILE_PATTERN_meta-tiff-app = "^${LAYERDIR}/"
BBFILE_PRIORITY_meta-tiff-app = "6"
```

## Task/conf/layer.conf
```bitbake
# We have a conf and classes directory, add to BBPATH
BBPATH .= ":${LAYERDIR}"

# We have recipes-* directories, add to BBFILES
BBFILES += "${LAYERDIR}/recipes-*/*/*.bb \
            ${LAYERDIR}/recipes-*/*/*.bbappend"

BBFILE_COLLECTIONS += "meta-animal-app"
BBFILE_PATTERN_meta-animal-app = "^${LAYERDIR}/"
BBFILE_PRIORITY_meta-animal-app = "6"
```
